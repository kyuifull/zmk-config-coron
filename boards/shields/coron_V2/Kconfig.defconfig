## boards/shields/coron_V2/Kconfig.defconfig
```kconfig
if SHIELD_CORON_V2_R

config ZMK_KEYBOARD_NAME
    default "Coron"

config ZMK_SPLIT
    default y

config ZMK_SPLIT_ROLE_CENTRAL
    default y

config ZMK_POINTING
    default y

config PAW3222
    default y

endif

if SHIELD_CORON_V2_L

config ZMK_KEYBOARD_NAME
    default "coron_L"

config ZMK_SPLIT
    default y

endif
```

## boards/shields/coron_V2/Kconfig.shield
```kconfig
config SHIELD_CORON_V2_R
    def_bool $(shields_list_contains,coron_V2_R)

config SHIELD_CORON_V2_L
    def_bool $(shields_list_contains,coron_V2_L)
```
